## build-uart/Kconfig/arch/Kconfig
```kconfig
# Load Zephyr Arch Kconfig descriptions.
osource "/opt/nordic/ncs/v3.2.0/zephyr/arch/rx/Kconfig"
osource "/opt/nordic/ncs/v3.2.0/zephyr/arch/x86/Kconfig"
osource "/opt/nordic/ncs/v3.2.0/zephyr/arch/xtensa/Kconfig"
osource "/opt/nordic/ncs/v3.2.0/zephyr/arch/sparc/Kconfig"
osource "/opt/nordic/ncs/v3.2.0/zephyr/arch/riscv/Kconfig"
osource "/opt/nordic/ncs/v3.2.0/zephyr/arch/posix/Kconfig"
osource "/opt/nordic/ncs/v3.2.0/zephyr/arch/mips/Kconfig"
osource "/opt/nordic/ncs/v3.2.0/zephyr/arch/arm64/Kconfig"
osource "/opt/nordic/ncs/v3.2.0/zephyr/arch/arm/Kconfig"
osource "/opt/nordic/ncs/v3.2.0/zephyr/arch/arc/Kconfig"
```

## build-uart/Kconfig/boards/Kconfig.defconfig
```kconfig
# Load Zephyr board defconfig descriptions.
osource "/opt/nordic/ncs/v3.2.0/zephyr/boards/nordic/nrf54l15dk/Kconfig.defconfig"
```
