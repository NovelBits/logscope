## CMakeLists.txt
```
cmake_minimum_required(VERSION 3.20.0)
find_package(Zephyr REQUIRED HINTS $ENV{ZEPHYR_BASE})
project(logscope-uart-demo)
target_sources(app PRIVATE
  src/main.c
  src/sensor_drv.c
  src/flash_mgr.c
  src/crypto_mgr.c
)
```

## prj.conf
```kconfig
# LogScope UART Demo — nRF54L15 DK
# Logging over UART for testing LogScope serial transport
# Build: west build -b nrf54l15dk/nrf54l15/cpuapp samples/nrf54l15-uart-demo --build-dir build-uart -p
# Flash: west flash --build-dir build-uart
# Serial port: /dev/ttyACM* (115200 baud)

# Logging over UART
CONFIG_LOG=y
CONFIG_LOG_MODE_DEFERRED=y
CONFIG_LOG_DEFAULT_LEVEL=3
CONFIG_LOG_MAX_LEVEL=4
CONFIG_LOG_BUFFER_SIZE=8192
CONFIG_LOG_BACKEND_UART=y
CONFIG_LOG_BACKEND_RTT=n
CONFIG_CONSOLE=y
CONFIG_UART_CONSOLE=y
CONFIG_RTT_CONSOLE=n

# Stack size (needed for burst logging)
CONFIG_MAIN_STACK_SIZE=4096
```

## overlay-8e1.overlay
```dts
/*
 * UART overlay: 8 data bits, EVEN parity, 1 stop bit.
 * Build with: -DEXTRA_DTC_OVERLAY_FILE=overlay-8e1.overlay
 * LogScope test settings: dataBits=8, parity="even", stopBits="1"
 */
&uart20 {
    parity = "even";
};
```

## overlay-8n2.overlay
```dts
/*
 * UART overlay: 8 data bits, NO parity, 2 stop bits.
 * Build with: -DEXTRA_DTC_OVERLAY_FILE=overlay-8n2.overlay
 * LogScope test settings: dataBits=8, parity="none", stopBits="2"
 */
&uart20 {
    stop-bits = "2";
};
```

## src/main.c
```c
/*
 * LogScope UART Demo — nRF54L15 DK
 *
 * Logging demo over UART for testing LogScope serial transport.
 * Modules: app, sensor_drv, flash_mgr, crypto_mgr
 * All severity levels cycling at different intervals.
 *
 * Build:
 *   source samples/nrf54l15-uart-demo/setup-env.sh
 *   west build -b nrf54l15dk/nrf54l15/cpuapp samples/nrf54l15-uart-demo --build-dir build-uart -p
 *   west flash --build-dir build-uart
 */

#include <zephyr/kernel.h>
#include <zephyr/logging/log.h>
#include "modules.h"

LOG_MODULE_REGISTER(app, LOG_LEVEL_DBG);

int main(void)
{
	LOG_INF("LogScope UART Demo starting");
	LOG_INF("Logging over UART at 115200 baud");

	/* Initialize modules */
	sensor_drv_init();
	flash_mgr_init();
	crypto_mgr_init();

	int cycle = 0;

	while (1) {
		cycle++;

		/* Sensor readings every 2 seconds */
		if (cycle % 2 == 0) {
			sensor_drv_read(cycle);
		}

		/* Flash activity */
		flash_mgr_tick(cycle);

		/* Crypto activity */
		crypto_mgr_tick(cycle);

		/* Heartbeat every 5 seconds */
		if (cycle % 5 == 0) {
			LOG_INF("Heartbeat %d: uptime %lld ms",
				cycle, k_uptime_get());
		}

		k_sleep(K_SECONDS(1));
	}

	return 0;
}
```

## src/crypto_mgr.c
```c
/*
 * Simulated crypto manager — AES-128-CCM encryption operations
 * Registers as its own Zephyr log module for proper filtering in LogScope.
 */

#include <zephyr/kernel.h>
#include <zephyr/logging/log.h>
#include "modules.h"

LOG_MODULE_REGISTER(crypto_mgr, LOG_LEVEL_DBG);

void crypto_mgr_init(void)
{
	LOG_INF("Hardware crypto engine initialized (AES-128-CCM)");
}

void crypto_mgr_tick(int cycle)
{
	if (cycle % 4 == 0) {
		LOG_DBG("AES-128-CCM encrypt: 64B payload, nonce=0x%08x", cycle * 0x1234);
	}
	if (cycle % 30 == 0) {
		LOG_ERR("MAC verification failed (expected: 0x%08x, got: 0x%08x)",
			0xDEADBEEF, 0xBADC0FFE);
	}
	if (cycle % 15 == 0) {
		LOG_WRN("Key rotation due: current key age %d hours", 12 + cycle / 15);
	}
}
```

## src/flash_mgr.c
```c
/*
 * Simulated flash manager — NOR flash operations with wear leveling
 * Registers as its own Zephyr log module for proper filtering in LogScope.
 */

#include <zephyr/kernel.h>
#include <zephyr/logging/log.h>
#include "modules.h"

LOG_MODULE_REGISTER(flash_mgr, LOG_LEVEL_DBG);

void flash_mgr_init(void)
{
	LOG_INF("Flash subsystem ready (NOR, 1MB, sector size 4KB)");
	LOG_DBG("Wear leveling table loaded: 256 sectors tracked");
}

void flash_mgr_tick(int cycle)
{
	uint32_t addr = 0x00080000 + (cycle * 256) % 0x10000;

	if (cycle % 15 == 0) {
		LOG_WRN("Flash wear level high on sector 0x%08x (writes: %d)",
			addr & 0xFFFF0000, 8500 + cycle);
	}
	if (cycle % 30 == 0) {
		LOG_ERR("Flash write failed at 0x%08x (timeout after 50ms)", addr);
	}
	if (cycle % 5 == 0) {
		LOG_DBG("Write 256B to 0x%08x (queue depth: %d)", addr, cycle % 8);
	}
}
```

## src/modules.h
```c
/*
 * LogScope UART Demo — shared declarations for simulated modules
 */

#ifndef LOGSCOPE_DEMO_MODULES_H
#define LOGSCOPE_DEMO_MODULES_H

#include <stdint.h>
#include <stdbool.h>

/* Sensor driver */
void sensor_drv_init(void);
void sensor_drv_read(int cycle);
uint32_t sensor_drv_get_value(void);

/* Flash manager */
void flash_mgr_init(void);
void flash_mgr_tick(int cycle);

/* Crypto manager */
void crypto_mgr_init(void);
void crypto_mgr_tick(int cycle);

#endif
```

## src/sensor_drv.c
```c
/*
 * Simulated sensor driver — temperature, humidity, accelerometer
 * Registers as its own Zephyr log module for proper filtering in LogScope.
 */

#include <zephyr/kernel.h>
#include <zephyr/logging/log.h>
#include "modules.h"

LOG_MODULE_REGISTER(sensor_drv, LOG_LEVEL_DBG);

static uint32_t sensor_value;

void sensor_drv_init(void)
{
	LOG_INF("Initializing temperature + humidity + accelerometer");
	LOG_DBG("I2C bus scan: found 3 devices at 0x48, 0x40, 0x68");
	LOG_INF("Sensor calibration loaded (factory defaults)");
}

void sensor_drv_read(int cycle)
{
	sensor_value += 17 + (cycle % 7);
	int16_t temp = 2200 + (cycle % 50) - 25;
	uint16_t humidity = 4500 + (cycle % 100);
	int16_t accel_x = (cycle * 3) % 200 - 100;
	int16_t accel_y = (cycle * 7) % 200 - 100;
	int16_t accel_z = 980 + (cycle % 20) - 10;

	LOG_DBG("Temp: %d.%02dC, Humidity: %d.%02d%%, Accel: (%d, %d, %d) mg",
		temp / 100, temp % 100, humidity / 100, humidity % 100,
		accel_x, accel_y, accel_z);
}

uint32_t sensor_drv_get_value(void)
{
	return sensor_value;
}
```
