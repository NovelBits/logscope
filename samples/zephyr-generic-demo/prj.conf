## CMakeLists.txt
```
cmake_minimum_required(VERSION 3.20.0)
find_package(Zephyr REQUIRED HINTS $ENV{ZEPHYR_BASE})
project(logscope-generic-demo)
target_sources(app PRIVATE
  src/main.c
  src/sensor_drv.c
  src/flash_mgr.c
  src/crypto_mgr.c
)
```

## prj.conf
```kconfig
# LogScope Generic Zephyr Demo
# Works on any Zephyr-supported board with SEGGER RTT (J-Link probe required)

# Logging over RTT
CONFIG_LOG=y
CONFIG_LOG_MODE_DEFERRED=y
CONFIG_LOG_DEFAULT_LEVEL=3
CONFIG_LOG_MAX_LEVEL=4
CONFIG_LOG_BUFFER_SIZE=8192
CONFIG_USE_SEGGER_RTT=y
CONFIG_LOG_BACKEND_RTT=y
CONFIG_LOG_BACKEND_UART=n
CONFIG_CONSOLE=y
CONFIG_RTT_CONSOLE=y
CONFIG_UART_CONSOLE=n

# RTT buffer config
CONFIG_SEGGER_RTT_MAX_NUM_UP_BUFFERS=3
CONFIG_SEGGER_RTT_BUFFER_SIZE_UP=8192
CONFIG_SEGGER_RTT_MODE_NO_BLOCK_SKIP=y

# GPIO for buttons
CONFIG_GPIO=y

# Stack size
CONFIG_MAIN_STACK_SIZE=4096
```

## uart.conf
```kconfig
# UART overlay for boards without J-Link (e.g., STM32 Nucleo with ST-Link)
# Build with: west build -b <board> samples/zephyr-generic-demo -- -DEXTRA_CONF_FILE=uart.conf

# Disable RTT
CONFIG_USE_SEGGER_RTT=n
CONFIG_LOG_BACKEND_RTT=n
CONFIG_RTT_CONSOLE=n
CONFIG_SEGGER_RTT_MAX_NUM_UP_BUFFERS=0

# Enable UART logging
CONFIG_LOG_BACKEND_UART=y
CONFIG_UART_CONSOLE=y
CONFIG_SERIAL=y
```

## src/main.c
```c
/*
 * LogScope Generic Zephyr Demo (any board with J-Link RTT)
 *
 * Platform-independent logging showcase using standard Zephyr APIs.
 * No Nordic-specific dependencies. Works on any board that has:
 *   - SEGGER RTT support (J-Link probe)
 *   - GPIO buttons defined as sw0-sw3 in devicetree (optional)
 *
 * Modules: app (main), sensor_drv, flash_mgr, crypto_mgr
 * All severity levels cycling at different intervals.
 * Buttons (if available) trigger interactive demo scenarios.
 *
 * Buttons:
 *   sw0 (Button 0): Sensor anomaly sequence
 *   sw1 (Button 1): Flash corruption and recovery sequence
 *   sw2 (Button 2): Stress burst (50 rapid-fire messages)
 *   sw3 (Button 3): Reserved (logs "no action assigned")
 *
 * Suggested watch patterns for LogScope:
 *   { "name": "Errors",          "pattern": "failed|error|fault|CRC|timeout",     "regex": true, "color": "#f44336" }
 *   { "name": "Retransmission",  "pattern": "Retransmission",                                    "color": "#ff9800" }
 *   { "name": "Heartbeat",       "pattern": "Heartbeat",                                         "color": "#4caf50" }
 *
 * Build (example for nRF52840 DK):
 *   west build -b nrf52840dk/nrf52840 samples/zephyr-generic-demo -p
 *   west flash
 *
 * Build (example for nRF54L15 DK):
 *   west build -b nrf54l15dk/nrf54l15/cpuapp samples/zephyr-generic-demo -p
 *   west flash
 *
 * Build (example for STM32 Nucleo):
 *   west build -b nucleo_f446re samples/zephyr-generic-demo -p
 *   west flash
 */

#include <zephyr/kernel.h>
#include <zephyr/logging/log.h>
#include <zephyr/drivers/gpio.h>
#include "modules.h"

LOG_MODULE_REGISTER(app, LOG_LEVEL_DBG);

/* ── Button setup (optional, uses devicetree sw0-sw3 aliases) ── */

/* Check which buttons exist in devicetree */
#if DT_NODE_EXISTS(DT_ALIAS(sw0))
#define HAS_BTN0 1
static const struct gpio_dt_spec btn0 = GPIO_DT_SPEC_GET(DT_ALIAS(sw0), gpios);
#endif

#if DT_NODE_EXISTS(DT_ALIAS(sw1))
#define HAS_BTN1 1
static const struct gpio_dt_spec btn1 = GPIO_DT_SPEC_GET(DT_ALIAS(sw1), gpios);
#endif

#if DT_NODE_EXISTS(DT_ALIAS(sw2))
#define HAS_BTN2 1
static const struct gpio_dt_spec btn2 = GPIO_DT_SPEC_GET(DT_ALIAS(sw2), gpios);
#endif

#if DT_NODE_EXISTS(DT_ALIAS(sw3))
#define HAS_BTN3 1
static const struct gpio_dt_spec btn3 = GPIO_DT_SPEC_GET(DT_ALIAS(sw3), gpios);
#endif

static struct gpio_callback btn_cb_data;
static volatile bool btn0_pressed;
static volatile bool btn1_pressed;
static volatile bool btn2_pressed;
static volatile bool btn3_pressed;

static void button_isr(const struct device *dev, struct gpio_callback *cb, uint32_t pins)
{
	ARG_UNUSED(dev);
	ARG_UNUSED(cb);

#ifdef HAS_BTN0
	if (pins & BIT(btn0.pin)) { btn0_pressed = true; }
#endif
#ifdef HAS_BTN1
	if (pins & BIT(btn1.pin)) { btn1_pressed = true; }
#endif
#ifdef HAS_BTN2
	if (pins & BIT(btn2.pin)) { btn2_pressed = true; }
#endif
#ifdef HAS_BTN3
	if (pins & BIT(btn3.pin)) { btn3_pressed = true; }
#endif
}

static int init_buttons(void)
{
	int err;
	uint32_t pin_mask = 0;

#ifdef HAS_BTN0
	if (!gpio_is_ready_dt(&btn0)) {
		LOG_WRN("Button 0 GPIO not ready, skipping");
	} else {
		err = gpio_pin_configure_dt(&btn0, GPIO_INPUT);
		if (err == 0) {
			err = gpio_pin_interrupt_configure_dt(&btn0, GPIO_INT_EDGE_TO_ACTIVE);
		}
		if (err == 0) {
			pin_mask |= BIT(btn0.pin);
			LOG_DBG("Button 0 (sw0) configured on pin %d", btn0.pin);
		}
	}
#endif
#ifdef HAS_BTN1
	if (!gpio_is_ready_dt(&btn1)) {
		LOG_WRN("Button 1 GPIO not ready, skipping");
	} else {
		err = gpio_pin_configure_dt(&btn1, GPIO_INPUT);
		if (err == 0) {
			err = gpio_pin_interrupt_configure_dt(&btn1, GPIO_INT_EDGE_TO_ACTIVE);
		}
		if (err == 0) {
			pin_mask |= BIT(btn1.pin);
			LOG_DBG("Button 1 (sw1) configured on pin %d", btn1.pin);
		}
	}
#endif
#ifdef HAS_BTN2
	if (!gpio_is_ready_dt(&btn2)) {
		LOG_WRN("Button 2 GPIO not ready, skipping");
	} else {
		err = gpio_pin_configure_dt(&btn2, GPIO_INPUT);
		if (err == 0) {
			err = gpio_pin_interrupt_configure_dt(&btn2, GPIO_INT_EDGE_TO_ACTIVE);
		}
		if (err == 0) {
			pin_mask |= BIT(btn2.pin);
			LOG_DBG("Button 2 (sw2) configured on pin %d", btn2.pin);
		}
	}
#endif
#ifdef HAS_BTN3
	if (!gpio_is_ready_dt(&btn3)) {
		LOG_WRN("Button 3 GPIO not ready, skipping");
	} else {
		err = gpio_pin_configure_dt(&btn3, GPIO_INPUT);
		if (err == 0) {
			err = gpio_pin_interrupt_configure_dt(&btn3, GPIO_INT_EDGE_TO_ACTIVE);
		}
		if (err == 0) {
			pin_mask |= BIT(btn3.pin);
			LOG_DBG("Button 3 (sw3) configured on pin %d", btn3.pin);
		}
	}
#endif

	if (pin_mask == 0) {
		LOG_INF("No buttons found in devicetree (demo runs without button triggers)");
		return 0;
	}

	/* All buttons share one GPIO port on most boards */
#ifdef HAS_BTN0
	gpio_init_callback(&btn_cb_data, button_isr, pin_mask);
	gpio_add_callback(btn0.port, &btn_cb_data);
#endif

	int count = __builtin_popcount(pin_mask);
	LOG_INF("Buttons initialized (%d button%s ready)", count, count > 1 ? "s" : "");
	return 0;
}

/* ── Burst mode ────────────────────────────────────────────── */
static int burst_remaining;

void burst_run(int *remaining)
{
	int n = 50 - *remaining;

	switch (*remaining % 10) {
	case 0:
		LOG_ERR("Retransmission timeout on channel 3 (attempt 2/3)");
		break;
	case 1:
		LOG_WRN("Sensor calibration drift detected: 0.3C");
		break;
	case 2:
		LOG_ERR("CRC mismatch during burst write at 0x%08x", 0x80000 + n * 256);
		break;
	case 3:
		LOG_WRN("Key derivation took 45ms (threshold: 20ms)");
		break;
	case 4:
		LOG_INF("Connection event missed, scheduling recovery");
		break;
	case 5:
		LOG_ERR("Flash write failed at 0x%08x (timeout after 50ms)", 0x90000 + n * 256);
		break;
	case 6:
		LOG_WRN("RSSI dropped to -89 dBm (threshold: -80 dBm)");
		break;
	case 7:
		LOG_INF("Notification queued (pending: %d)", n % 8 + 1);
		break;
	case 8:
		LOG_ERR("MAC verification failed (expected: 0x%08x, got: 0x%08x)",
			0xDEADBEEF, 0xBADC0FFE + n);
		break;
	case 9:
		LOG_DBG("AES-128-CCM encrypt: 64B payload, nonce=0x%08x", n * 0x1234);
		break;
	}

	(*remaining)--;
	if (*remaining == 0) {
		LOG_INF("Burst complete (50 messages sent)");
	}
}

/* ── Retransmission counter ────────────────────────────────── */
static int retransmission_seq;

/* ── Process button presses ─��──────────────────────────────── */
static void process_buttons(void)
{
	if (btn0_pressed) {
		btn0_pressed = false;
		sensor_drv_anomaly();
	}

	if (btn1_pressed) {
		btn1_pressed = false;
		flash_mgr_corruption();
	}

	if (btn2_pressed) {
		btn2_pressed = false;
		LOG_WRN("Stress burst triggered via button (50 messages)");
		burst_remaining = 50;
	}

	if (btn3_pressed) {
		btn3_pressed = false;
		LOG_INF("Button 3: no action assigned (reserved for future use)");
	}
}

/* ── Main ────────────────────────────────��─────────────────── */
int main(void)
{
	LOG_INF("LogScope Generic Zephyr Demo starting");
	LOG_INF("Platform: %s", CONFIG_BOARD);
	LOG_INF("Buttons: 0=sensor anomaly, 1=flash corruption, 2=stress burst");

	/* Initialize modules */
	sensor_drv_init();
	flash_mgr_init();
	crypto_mgr_init();

	/* Initialize buttons (graceful if none exist) */
	init_buttons();

	int cycle = 0;

	while (1) {
		cycle++;

		/* Process button presses (flags set in ISR) */
		process_buttons();

		/* Burst mode: rapid-fire logging */
		if (burst_remaining > 0) {
			burst_run(&burst_remaining);
			k_sleep(K_MSEC(20));
			continue;
		}

		/* Sensor readings every 2 seconds */
		if (cycle % 2 == 0) {
			sensor_drv_read(cycle);
		}

		/* Flash activity */
		flash_mgr_tick(cycle);

		/* Crypto activity */
		crypto_mgr_tick(cycle);

		/* Heartbeat every 5 seconds */
		if (cycle % 5 == 0) {
			LOG_INF("Heartbeat %d: uptime %lld ms", cycle, k_uptime_get());
		}

		/* Retransmission warning (pseudo-random: every 8-12 seconds) */
		if ((cycle * 7 + 3) % 11 == 0) {
			retransmission_seq++;
			LOG_WRN("Retransmission on handle 0x0040 (seq: %d, attempt: 1)",
				retransmission_seq);
		}

		/* Battery check every 45 seconds */
		if (cycle % 45 == 0) {
			int voltage_mv = 3100 + (cycle % 200) - 100;
			int pct = (voltage_mv - 2700) * 100 / 900;
			if (pct < 100) pct = (pct < 0) ? 0 : pct;
			if (pct < 20) {
				LOG_WRN("Battery: %d.%dV (%d%% remaining)",
					voltage_mv / 1000, (voltage_mv % 1000) / 100, pct);
			} else {
				LOG_INF("Battery: %d.%dV (%d%% remaining)",
					voltage_mv / 1000, (voltage_mv % 1000) / 100, pct);
			}
		}

		k_sleep(K_SECONDS(1));
	}

	return 0;
}
```

## src/crypto_mgr.c
```c
/*
 * Simulated crypto manager -- AES-128-CCM encryption operations
 * Registers as its own Zephyr log module for proper filtering in LogScope.
 */

#include <zephyr/kernel.h>
#include <zephyr/logging/log.h>
#include "modules.h"

LOG_MODULE_REGISTER(crypto_mgr, LOG_LEVEL_DBG);

void crypto_mgr_init(void)
{
	LOG_INF("Hardware crypto engine initialized (AES-128-CCM)");
}

void crypto_mgr_tick(int cycle)
{
	if (cycle % 4 == 0) {
		LOG_DBG("AES-128-CCM encrypt: 64B payload, nonce=0x%08x", cycle * 0x1234);
	}
	if (cycle % 30 == 0) {
		LOG_ERR("MAC verification failed (expected: 0x%08x, got: 0x%08x)",
			0xDEADBEEF, 0xBADC0FFE);
	}
	if (cycle % 15 == 0) {
		LOG_WRN("Key rotation due: current key age %d hours", 12 + cycle / 15);
	}
}
```

## src/flash_mgr.c
```c
/*
 * Simulated flash manager -- NOR flash operations with wear leveling
 * Registers as its own Zephyr log module for proper filtering in LogScope.
 */

#include <zephyr/kernel.h>
#include <zephyr/logging/log.h>
#include "modules.h"

LOG_MODULE_REGISTER(flash_mgr, LOG_LEVEL_DBG);

void flash_mgr_init(void)
{
	LOG_INF("Flash subsystem ready (NOR, 1MB, sector size 4KB)");
	LOG_DBG("Wear leveling table loaded: 256 sectors tracked");
}

void flash_mgr_tick(int cycle)
{
	uint32_t addr = 0x00080000 + (cycle * 256) % 0x10000;

	if (cycle % 15 == 0) {
		LOG_WRN("Flash wear level high on sector 0x%08x (writes: %d)",
			addr & 0xFFFF0000, 8500 + cycle);
	}
	if (cycle % 30 == 0) {
		LOG_ERR("Flash write failed at 0x%08x (timeout after 50ms)", addr);
	}
	if (cycle % 5 == 0) {
		LOG_DBG("Write 256B to 0x%08x (queue depth: %d)", addr, cycle % 8);
	}
}

/* Button 2: Flash corruption and recovery sequence */
void flash_mgr_corruption(void)
{
	LOG_ERR("CRC mismatch at sector 0x00080000 (expected: 0xA3F1, got: 0x0000)");
	LOG_WRN("Wear level critical on sector 0x00080000 (writes: 99847)");
	LOG_ERR("Flash write failed at 0x00080000 (ECC error)");
	LOG_INF("Sector 0x00080000 marked bad, remapping to 0x000A0000");
	LOG_INF("Flash recovery complete, 1 sector remapped");
}
```

## src/modules.h
```c
/*
 * LogScope Generic Demo -- shared declarations for simulated modules
 */

#ifndef LOGSCOPE_DEMO_MODULES_H
#define LOGSCOPE_DEMO_MODULES_H

#include <stdint.h>
#include <stdbool.h>

/* Sensor driver */
void sensor_drv_init(void);
void sensor_drv_read(int cycle);
uint32_t sensor_drv_get_value(void);
void sensor_drv_anomaly(void);

/* Flash manager */
void flash_mgr_init(void);
void flash_mgr_tick(int cycle);
void flash_mgr_corruption(void);

/* Crypto manager */
void crypto_mgr_init(void);
void crypto_mgr_tick(int cycle);

/* Burst mode */
void burst_run(int *remaining);

#endif
```

## src/sensor_drv.c
```c
/*
 * Simulated sensor driver -- temperature, humidity, accelerometer
 * Registers as its own Zephyr log module for proper filtering in LogScope.
 */

#include <zephyr/kernel.h>
#include <zephyr/logging/log.h>
#include "modules.h"

LOG_MODULE_REGISTER(sensor_drv, LOG_LEVEL_DBG);

static uint32_t sensor_value;

void sensor_drv_init(void)
{
	LOG_INF("Initializing temperature + humidity + accelerometer");
	LOG_DBG("I2C bus scan: found 3 devices at 0x48, 0x40, 0x68");
	LOG_INF("Sensor calibration loaded (factory defaults)");
}

void sensor_drv_read(int cycle)
{
	sensor_value += 17 + (cycle % 7);
	int16_t temp = 2200 + (cycle % 50) - 25;
	uint16_t humidity = 4500 + (cycle % 100);
	int16_t accel_x = (cycle * 3) % 200 - 100;
	int16_t accel_y = (cycle * 7) % 200 - 100;
	int16_t accel_z = 980 + (cycle % 20) - 10;

	LOG_DBG("Temp: %d.%02dC, Humidity: %d.%02d%%, Accel: (%d, %d, %d) mg",
		temp / 100, temp % 100, humidity / 100, humidity % 100,
		accel_x, accel_y, accel_z);
}

uint32_t sensor_drv_get_value(void)
{
	return sensor_value;
}

/* Button 1: Sensor anomaly sequence */
void sensor_drv_anomaly(void)
{
	LOG_INF("Anomaly detected: temperature spike to 85.2C (threshold: 60.0C)");
	LOG_WRN("Thermal threshold exceeded, initiating cooldown");
	LOG_ERR("Sensor read timeout during thermal event (retry 1/3)");
	LOG_INF("Temperature returning to normal: 24.8C");
}
```
