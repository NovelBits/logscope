## CMakeLists.txt
```
cmake_minimum_required(VERSION 3.20.0)
find_package(Zephyr REQUIRED HINTS $ENV{ZEPHYR_BASE})
project(logscope-silent-demo)
target_sources(app PRIVATE src/main.c)
```

## prj.conf
```kconfig
# LogScope Silent Demo — nRF54L15 DK
# Test fixture for the RTT silence-recovery path: prints two lines at boot,
# then goes silent forever. Used to reproduce issue #17 deterministically.
# Build: source samples/nrf54l15-uart-demo/setup-env.sh && \
#        west build -b nrf54l15dk/nrf54l15/cpuapp samples/nrf54l15-silent-demo --build-dir build-silent -p

CONFIG_LOG=y
CONFIG_LOG_MODE_DEFERRED=y
CONFIG_LOG_DEFAULT_LEVEL=3
CONFIG_USE_SEGGER_RTT=y
CONFIG_LOG_BACKEND_RTT=y
CONFIG_LOG_BACKEND_UART=n
CONFIG_CONSOLE=y
CONFIG_RTT_CONSOLE=y
CONFIG_UART_CONSOLE=n

CONFIG_MAIN_STACK_SIZE=2048
```

## src/main.c
```c
/*
 * LogScope Silent Demo
 *
 * Logs two lines at boot, then sleeps forever. Used to reproduce and verify
 * the fix for the RTT silence-recovery loop (issue #17). Without firmware
 * activity to keep the RTT channel busy, the silence-detection path is
 * exercised cleanly — no need to fight chatty BLE/sensor logs.
 */

#include <zephyr/kernel.h>
#include <zephyr/logging/log.h>

LOG_MODULE_REGISTER(silent_demo, LOG_LEVEL_INF);

int main(void)
{
	LOG_INF("Silent demo booted on %s", CONFIG_BOARD);
	LOG_INF("Going silent — verifying RTT silence recovery (issue #17)");
	k_sleep(K_FOREVER);
	return 0;
}
```
