## prj.conf
```kconfig
# LogScope Bluetooth LE HCI Demo — nRF54L15 DK
# Rich logging stress test: multiple modules, all severities, custom GATT service

# Bluetooth LE
CONFIG_BT=y
CONFIG_BT_PERIPHERAL=y
CONFIG_BT_DEVICE_NAME="LogScope Demo"
CONFIG_BT_DIS=y
CONFIG_BT_DIS_MANUF_NAME=y
CONFIG_BT_DIS_MANUF_NAME_STR="Novel Bits"
CONFIG_BT_DIS_MODEL_NUMBER=y
CONFIG_BT_DIS_MODEL_NUMBER_STR="nRF54L15 DK"

# GATT service support
CONFIG_BT_GATT_DYNAMIC_DB=y
CONFIG_BT_ATT_PREPARE_COUNT=5

# Logging over RTT
CONFIG_LOG=y
CONFIG_LOG_MODE_DEFERRED=y
CONFIG_LOG_DEFAULT_LEVEL=3
CONFIG_LOG_MAX_LEVEL=4
CONFIG_LOG_BUFFER_SIZE=8192
CONFIG_USE_SEGGER_RTT=y
CONFIG_LOG_BACKEND_RTT=y
CONFIG_LOG_BACKEND_UART=n
CONFIG_CONSOLE=y
CONFIG_RTT_CONSOLE=y
CONFIG_UART_CONSOLE=n

# RTT buffer config (Channel 0 = console, Channel 1 = btmonitor)
CONFIG_SEGGER_RTT_MAX_NUM_UP_BUFFERS=3
CONFIG_SEGGER_RTT_BUFFER_SIZE_UP=8192
CONFIG_SEGGER_RTT_MODE_NO_BLOCK_SKIP=y

# HCI tracing over RTT Channel 1 (BT Monitor protocol)
CONFIG_BT_DEBUG_MONITOR_RTT=y

# DK buttons
CONFIG_DK_LIBRARY=y
CONFIG_GPIO=y

# Stack size (needed for burst logging)
CONFIG_MAIN_STACK_SIZE=4096
```

## src/main.c
```c
/*
 * LogScope Bluetooth LE HCI Demo — nRF54L15 DK (Showcase)
 *
 * Rich logging demo with proper Zephyr log modules:
 * - app (main), sensor_drv, flash_mgr, crypto_mgr, ble_mgr
 * - All severity levels cycling at different intervals
 * - Custom GATT service (read/write/notify)
 * - Burst mode (write 0x01 to command characteristic)
 * - HCI traces on RTT Channel 1
 * - 4 DK buttons for interactive demo scenarios
 *
 * Buttons:
 *   Button 0: Toggle advertising (idle) / Force disconnect (connected)
 *   Button 1: Sensor anomaly sequence + notification burst (if connected)
 *   Button 2: Flash corruption and recovery sequence
 *   Button 3: Stress burst (50 rapid-fire messages)
 *
 * What HCI traffic to expect (so the LogScope HCI decoder always has
 * something to show):
 *   - Init burst (~1s at boot): bt_enable + advertising start emit
 *     several HCI commands and complete events.
 *   - Idle advertising (every 20s): the demo refreshes advertising data
 *     periodically, which emits "LE Set Advertising Data" + complete
 *     event. Without this, BLE peripherals are HCI-quiet between
 *     connections — the controller is just radio-advertising in the
 *     background, which doesn't generate HCI per advertising event.
 *   - Connection: when a central connects (use nRF Connect Mobile to
 *     scan for "LogScope Demo"), connection events flow through HCI.
 *   - Button presses: trigger advertising toggle / disconnect / GATT
 *     activity, all of which generate HCI traffic.
 *
 * Suggested watch patterns for LogScope:
 *   { "name": "BLE State",       "pattern": "Connected|Disconnected|Advertising", "regex": true, "color": "#4caf50" }
 *   { "name": "Errors",          "pattern": "failed|error|fault|CRC|timeout",     "regex": true, "color": "#f44336" }
 *   { "name": "Retransmission",  "pattern": "Retransmission",                                    "color": "#ff9800" }
 *
 * Build:
 *   source samples/nrf54l15-ble-hci-demo/setup-env.sh
 *   west build -b nrf54l15dk/nrf54l15/cpuapp samples/nrf54l15-ble-hci-demo --build-dir build-hci -p
 *   west flash --build-dir build-hci
 */

#include <zephyr/kernel.h>
#include <zephyr/logging/log.h>
#include <zephyr/bluetooth/bluetooth.h>
#include <zephyr/bluetooth/hci.h>
#include <zephyr/bluetooth/conn.h>
#include <zephyr/bluetooth/uuid.h>
#include <dk_buttons_and_leds.h>
#include "modules.h"

LOG_MODULE_REGISTER(app, LOG_LEVEL_DBG);

/* Shared burst state (accessed by ble_mgr.c) */
int burst_remaining;

/* Forward declarations from ble_mgr.c */
extern struct bt_conn *ble_mgr_get_conn(void);
extern void ble_mgr_set_conn(struct bt_conn *conn);

/* ── Advertising data ───────────────────────────────────────── */
/* 128-bit UUID as byte array for advertising data */
static const uint8_t logscope_svc_uuid_ad[] = {
	BT_UUID_128_ENCODE(0x12345678, 0x1234, 0x5678, 0x1234, 0x56789abcdef0)
};

static const struct bt_data ad[] = {
	BT_DATA_BYTES(BT_DATA_FLAGS, (BT_LE_AD_GENERAL | BT_LE_AD_NO_BREDR)),
	BT_DATA(BT_DATA_UUID128_ALL, logscope_svc_uuid_ad, sizeof(logscope_svc_uuid_ad)),
};

static const struct bt_data sd[] = {
	BT_DATA(BT_DATA_NAME_COMPLETE, CONFIG_BT_DEVICE_NAME,
		sizeof(CONFIG_BT_DEVICE_NAME) - 1),
};

/* ── Connection callbacks ───────────────────────────────────── */
static void connected(struct bt_conn *conn, uint8_t err)
{
	char addr[BT_ADDR_LE_STR_LEN];

	bt_addr_le_to_str(bt_conn_get_dst(conn), addr, sizeof(addr));

	if (err) {
		LOG_ERR("Connection failed (addr %s, err 0x%02x %s)",
			addr, err, bt_hci_err_to_str(err));
		return;
	}

	LOG_INF("Connected: %s", addr);
	ble_mgr_set_conn(conn);
	ble_mgr_on_connected();
}

static void disconnected(struct bt_conn *conn, uint8_t reason)
{
	char addr[BT_ADDR_LE_STR_LEN];

	bt_addr_le_to_str(bt_conn_get_dst(conn), addr, sizeof(addr));
	LOG_INF("Disconnected: %s (reason 0x%02x %s)",
		addr, reason, bt_hci_err_to_str(reason));

	ble_mgr_set_conn(NULL);
	ble_mgr_on_disconnected();

	int ret = bt_le_adv_start(BT_LE_ADV_CONN_FAST_1, ad, ARRAY_SIZE(ad),
				  sd, ARRAY_SIZE(sd));
	if (ret) {
		LOG_ERR("Re-advertising failed (err %d)", ret);
	} else {
		LOG_INF("Re-advertising started");
	}
}

static void le_param_updated(struct bt_conn *conn, uint16_t interval,
			     uint16_t latency, uint16_t timeout)
{
	LOG_INF("Connection params updated: interval %d (%.2f ms), latency %d, timeout %d",
		interval, interval * 1.25, latency, timeout);
}

BT_CONN_CB_DEFINE(conn_callbacks) = {
	.connected = connected,
	.disconnected = disconnected,
	.le_param_updated = le_param_updated,
};

/* ── Button flags (set in ISR, processed in main loop) ─────── */
static volatile bool btn0_pressed;
static volatile bool btn1_pressed;
static volatile bool btn2_pressed;
static volatile bool btn3_pressed;

static void button_handler(uint32_t button_state, uint32_t has_changed)
{
	if (has_changed & DK_BTN1_MSK && button_state & DK_BTN1_MSK) {
		btn0_pressed = true;
	}
	if (has_changed & DK_BTN2_MSK && button_state & DK_BTN2_MSK) {
		btn1_pressed = true;
	}
	if (has_changed & DK_BTN3_MSK && button_state & DK_BTN3_MSK) {
		btn2_pressed = true;
	}
	if (has_changed & DK_BTN4_MSK && button_state & DK_BTN4_MSK) {
		btn3_pressed = true;
	}
}

/* ── Retransmission counter (pseudo-random interval) ───────── */
static int retransmission_seq;

/* ── Burst mode (enhanced with realistic messages) ─────────── */
void burst_run(int *remaining)
{
	int n = 50 - *remaining;

	switch (*remaining % 10) {
	case 0:
		LOG_ERR("Retransmission timeout on channel 3 (attempt 2/3)");
		break;
	case 1:
		LOG_WRN("Sensor calibration drift detected: 0.3C");
		break;
	case 2:
		LOG_ERR("CRC mismatch during burst write at 0x%08x", 0x80000 + n * 256);
		break;
	case 3:
		LOG_WRN("Key derivation took 45ms (threshold: 20ms)");
		break;
	case 4:
		LOG_INF("Connection event missed, scheduling recovery");
		break;
	case 5:
		LOG_ERR("Flash write failed at 0x%08x (timeout after 50ms)", 0x90000 + n * 256);
		break;
	case 6:
		LOG_WRN("RSSI dropped to -89 dBm (threshold: -80 dBm)");
		break;
	case 7:
		LOG_INF("Notification queued (pending: %d)", n % 8 + 1);
		break;
	case 8:
		LOG_ERR("MAC verification failed (expected: 0x%08x, got: 0x%08x)",
			0xDEADBEEF, 0xBADC0FFE + n);
		break;
	case 9:
		LOG_DBG("AES-128-CCM encrypt: 64B payload, nonce=0x%08x", n * 0x1234);
		break;
	}

	(*remaining)--;
	if (*remaining == 0) {
		LOG_INF("Burst complete (50 messages sent)");
	}
}

/* ── Process button presses (called from main loop) ────────── */
static void process_buttons(void)
{
	bool connected = (ble_mgr_get_conn() != NULL);

	if (btn0_pressed) {
		btn0_pressed = false;
		if (connected) {
			ble_mgr_force_disconnect();
		} else {
			ble_mgr_toggle_advertising();
		}
	}

	if (btn1_pressed) {
		btn1_pressed = false;
		sensor_drv_anomaly(connected);
	}

	if (btn2_pressed) {
		btn2_pressed = false;
		flash_mgr_corruption();
	}

	if (btn3_pressed) {
		btn3_pressed = false;
		LOG_WRN("Stress burst triggered via Button 3 (50 messages)");
		burst_remaining = 50;
	}
}

/* ── Main ───────────────────────────────────────────────────── */
int main(void)
{
	int err;

	LOG_INF("LogScope Bluetooth LE HCI Demo starting (showcase)");
	LOG_INF("HCI traces streaming to RTT Channel 1");
	LOG_INF("Buttons: 0=BLE control, 1=sensor anomaly, 2=flash corruption, 3=stress burst");

	/* Initialize modules */
	sensor_drv_init();
	flash_mgr_init();
	crypto_mgr_init();

	/* Initialize DK buttons */
	err = dk_buttons_init(button_handler);
	if (err) {
		LOG_ERR("Button init failed (err %d)", err);
	} else {
		LOG_INF("DK buttons initialized (4 buttons ready)");
	}

	err = bt_enable(NULL);
	if (err) {
		LOG_ERR("Bluetooth init failed (err %d)", err);
		return 0;
	}

	LOG_INF("Bluetooth initialized");

	err = bt_le_adv_start(BT_LE_ADV_CONN_FAST_1, ad, ARRAY_SIZE(ad),
			      sd, ARRAY_SIZE(sd));
	if (err) {
		LOG_ERR("Advertising failed to start (err %d)", err);
		return 0;
	}

	LOG_INF("Advertising as \"%s\"", CONFIG_BT_DEVICE_NAME);
	ble_mgr_init();

	int cycle = 0;

	while (1) {
		cycle++;

		/* Process button presses (flags set in ISR) */
		process_buttons();

		/* Burst mode: rapid-fire logging */
		if (burst_remaining > 0) {
			burst_run(&burst_remaining);
			k_sleep(K_MSEC(20));
			continue;
		}

		/* Sensor readings every 2 seconds */
		if (cycle % 2 == 0) {
			sensor_drv_read(cycle);
			ble_mgr_send_notification(sensor_drv_get_value());
		}

		/* Flash activity */
		flash_mgr_tick(cycle);

		/* Crypto activity */
		crypto_mgr_tick(cycle);

		/* Bluetooth LE manager activity */
		ble_mgr_tick(cycle);

		/* Heartbeat every 5 seconds */
		if (cycle % 5 == 0) {
			if (ble_mgr_get_conn()) {
				LOG_INF("Heartbeat %d: connected, uptime %lld ms",
					cycle, k_uptime_get());
			} else {
				LOG_INF("Heartbeat %d: advertising, uptime %lld ms",
					cycle, k_uptime_get());
			}
		}

		/* Periodic advertising data refresh (every 20 seconds when not
		 * connected). Emits an HCI "LE Set Advertising Data" command +
		 * complete event so the LogScope HCI decoder always has fresh
		 * traffic to display, even when nothing else is happening. Without
		 * this, BLE peripherals are HCI-quiet between connections. */
		if (cycle % 20 == 0 && !ble_mgr_get_conn()) {
			int ret = bt_le_adv_update_data(ad, ARRAY_SIZE(ad), sd, ARRAY_SIZE(sd));
			if (ret == 0) {
				LOG_INF("Advertising data refreshed (HCI demo cycle %d)", cycle);
			} else if (ret == -EAGAIN) {
				/* Common: controller is busy switching state. Not an error. */
			} else {
				LOG_WRN("Advertising data refresh failed (err %d)", ret);
			}
		}

		/* Retransmission warning (pseudo-random: every 8-12 seconds) */
		if ((cycle * 7 + 3) % 11 == 0) {
			retransmission_seq++;
			LOG_WRN("Retransmission on handle 0x0040 (seq: %d, attempt: 1)",
				retransmission_seq);
		}

		/* Battery check every 45 seconds */
		if (cycle % 45 == 0) {
			int voltage_mv = 3100 + (cycle % 200) - 100;
			int pct = (voltage_mv - 2700) * 100 / 900;
			if (pct < 100) pct = (pct < 0) ? 0 : pct;
			if (pct < 20) {
				LOG_WRN("Battery: %d.%dV (%d%% remaining)",
					voltage_mv / 1000, (voltage_mv % 1000) / 100, pct);
			} else {
				LOG_INF("Battery: %d.%dV (%d%% remaining)",
					voltage_mv / 1000, (voltage_mv % 1000) / 100, pct);
			}
		}

		k_sleep(K_SECONDS(1));
	}

	return 0;
}
```

## src/ble_mgr.c
```c
/*
 * Bluetooth LE manager — GATT service, notifications, connection management
 * Registers as its own Zephyr log module for proper filtering in LogScope.
 */

#include <zephyr/kernel.h>
#include <zephyr/logging/log.h>
#include <zephyr/bluetooth/bluetooth.h>
#include <zephyr/bluetooth/conn.h>
#include <zephyr/bluetooth/uuid.h>
#include <zephyr/bluetooth/gatt.h>
#include <zephyr/sys/byteorder.h>
#include "modules.h"

LOG_MODULE_REGISTER(ble_mgr, LOG_LEVEL_DBG);

/* ── Custom GATT Service UUIDs ──────────────────────────────── */

static struct bt_uuid_128 logscope_svc_uuid = BT_UUID_INIT_128(
	BT_UUID_128_ENCODE(0x12345678, 0x1234, 0x5678, 0x1234, 0x56789abcdef0));

static struct bt_uuid_128 info_char_uuid = BT_UUID_INIT_128(
	BT_UUID_128_ENCODE(0x12345678, 0x1234, 0x5678, 0x1234, 0x56789abcdef1));

static struct bt_uuid_128 cmd_char_uuid = BT_UUID_INIT_128(
	BT_UUID_128_ENCODE(0x12345678, 0x1234, 0x5678, 0x1234, 0x56789abcdef2));

static struct bt_uuid_128 sensor_char_uuid = BT_UUID_INIT_128(
	BT_UUID_128_ENCODE(0x12345678, 0x1234, 0x5678, 0x1234, 0x56789abcdef3));

/* ── State ──────────────────────────────────────────────────── */
static struct bt_conn *current_conn;
static bool notify_enabled;
extern int burst_remaining;  /* defined in main.c */

/* ── GATT: Read characteristic (device info) ────────────────── */
static ssize_t read_info(struct bt_conn *conn, const struct bt_gatt_attr *attr,
			 void *buf, uint16_t len, uint16_t offset)
{
	const char *info = "LogScope Demo v2 | nRF54L15 DK | Novel Bits";

	LOG_DBG("GATT read: info characteristic");
	return bt_gatt_attr_read(conn, attr, buf, len, offset, info, strlen(info));
}

/* ── GATT: Write characteristic (command) ───────────────────── */
static ssize_t write_cmd(struct bt_conn *conn, const struct bt_gatt_attr *attr,
			 const void *buf, uint16_t len, uint16_t offset, uint8_t flags)
{
	if (len < 1) {
		return BT_GATT_ERR(BT_ATT_ERR_INVALID_ATTRIBUTE_LEN);
	}

	uint8_t cmd = ((const uint8_t *)buf)[0];

	switch (cmd) {
	case 0x01:
		LOG_WRN("Burst mode triggered via GATT write (50 messages)");
		burst_remaining = 50;
		break;
	case 0x02:
		LOG_INF("Reset sensor counter via GATT write");
		break;
	case 0x03:
		LOG_INF("Manual flash erase triggered via GATT");
		break;
	case 0x04:
		LOG_ERR("***** HARD FAULT *****");
		LOG_ERR("  Fault escalation (see below)");
		LOG_ERR("  r0/a1:  0x00000000  r1/a2:  0x00000004");
		LOG_ERR("  r12/ip: 0x00000000  r14/lr: 0x0000abcd");
		LOG_ERR("  Faulting instruction address: 0x00012345");
		LOG_ERR(">>> ZEPHYR FATAL ERROR 1: Unhandled interrupt");
		LOG_ERR("Halting system");
		break;
	case 0x05:
		LOG_ERR("Triggering real hard fault (invalid memory access)...");
		*((volatile uint32_t *)0xDEADBEEF) = 0;
		break;
	default:
		LOG_WRN("Unknown command byte: 0x%02x", cmd);
		break;
	}

	return len;
}

/* ── GATT: Notify characteristic (sensor data) ──────────────── */
static void sensor_ccc_changed(const struct bt_gatt_attr *attr, uint16_t value)
{
	notify_enabled = (value == BT_GATT_CCC_NOTIFY);
	LOG_INF("Sensor notifications %s", notify_enabled ? "enabled" : "disabled");
}

/* ── GATT Service Registration ──────────────────────────────── */
BT_GATT_SERVICE_DEFINE(logscope_svc,
	BT_GATT_PRIMARY_SERVICE(&logscope_svc_uuid),
	BT_GATT_CHARACTERISTIC(&info_char_uuid.uuid,
		BT_GATT_CHRC_READ, BT_GATT_PERM_READ,
		read_info, NULL, NULL),
	BT_GATT_CHARACTERISTIC(&cmd_char_uuid.uuid,
		BT_GATT_CHRC_WRITE, BT_GATT_PERM_WRITE,
		NULL, write_cmd, NULL),
	BT_GATT_CHARACTERISTIC(&sensor_char_uuid.uuid,
		BT_GATT_CHRC_NOTIFY, BT_GATT_PERM_NONE,
		NULL, NULL, NULL),
	BT_GATT_CCC(sensor_ccc_changed, BT_GATT_PERM_READ | BT_GATT_PERM_WRITE),
);

/* ── Public API ─────────────────────────────────────────────── */

void ble_mgr_init(void)
{
	LOG_INF("GATT service registered: read + write + notify characteristics");
}

void ble_mgr_on_connected(void)
{
	notify_enabled = false;
}

void ble_mgr_on_disconnected(void)
{
	notify_enabled = false;
}

struct bt_conn *ble_mgr_get_conn(void)
{
	return current_conn;
}

void ble_mgr_set_conn(struct bt_conn *conn)
{
	if (current_conn) {
		bt_conn_unref(current_conn);
	}
	current_conn = conn ? bt_conn_ref(conn) : NULL;
}

void ble_mgr_send_notification(uint32_t value)
{
	if (!current_conn || !notify_enabled) {
		return;
	}

	uint8_t data[4];
	sys_put_le32(value, data);

	int err = bt_gatt_notify(current_conn, &logscope_svc.attrs[7], data, sizeof(data));
	if (err) {
		LOG_WRN("Sensor notification failed (err %d)", err);
	} else {
		LOG_DBG("Sensor notification sent: value=%u", value);
	}
}

static bool adv_active = true;

/* Advertising data for restart (matches main.c) */
static const uint8_t svc_uuid_adv[] = {
	BT_UUID_128_ENCODE(0x12345678, 0x1234, 0x5678, 0x1234, 0x56789abcdef0)
};

static const struct bt_data restart_ad[] = {
	BT_DATA_BYTES(BT_DATA_FLAGS, (BT_LE_AD_GENERAL | BT_LE_AD_NO_BREDR)),
	BT_DATA(BT_DATA_UUID128_ALL, svc_uuid_adv, sizeof(svc_uuid_adv)),
};

static const struct bt_data restart_sd[] = {
	BT_DATA(BT_DATA_NAME_COMPLETE, CONFIG_BT_DEVICE_NAME,
		sizeof(CONFIG_BT_DEVICE_NAME) - 1),
};

void ble_mgr_toggle_advertising(void)
{
	if (adv_active) {
		bt_le_adv_stop();
		adv_active = false;
		LOG_INF("Advertising stopped by user");
	} else {
		int err = bt_le_adv_start(BT_LE_ADV_CONN_FAST_1,
					  restart_ad, ARRAY_SIZE(restart_ad),
					  restart_sd, ARRAY_SIZE(restart_sd));
		if (err) {
			LOG_ERR("Advertising restart failed (err %d)", err);
		} else {
			adv_active = true;
			LOG_INF("Advertising restarted by user");
		}
	}
}

void ble_mgr_force_disconnect(void)
{
	if (!current_conn) {
		LOG_WRN("No active connection to disconnect");
		return;
	}
	LOG_INF("User-initiated disconnect");
	bt_conn_disconnect(current_conn, BT_HCI_ERR_REMOTE_USER_TERM_CONN);
}

void ble_mgr_tick(int cycle)
{
	if (cycle % 10 == 0 && current_conn) {
		LOG_DBG("RSSI check scheduled for connection 0x0040");
	}
	if (cycle % 20 == 0) {
		LOG_INF("Advertising data updated (TX power: %d dBm)", -4 + (cycle % 3));
	}
}
```

## src/flash_mgr.c
```c
/*
 * Simulated flash manager — NOR flash operations with wear leveling
 * Registers as its own Zephyr log module for proper filtering in LogScope.
 */

#include <zephyr/kernel.h>
#include <zephyr/logging/log.h>
#include "modules.h"

LOG_MODULE_REGISTER(flash_mgr, LOG_LEVEL_DBG);

void flash_mgr_init(void)
{
	LOG_INF("Flash subsystem ready (NOR, 1MB, sector size 4KB)");
	LOG_DBG("Wear leveling table loaded: 256 sectors tracked");
}

void flash_mgr_tick(int cycle)
{
	uint32_t addr = 0x00080000 + (cycle * 256) % 0x10000;

	if (cycle % 15 == 0) {
		LOG_WRN("Flash wear level high on sector 0x%08x (writes: %d)",
			addr & 0xFFFF0000, 8500 + cycle);
	}
	if (cycle % 30 == 0) {
		LOG_ERR("Flash write failed at 0x%08x (timeout after 50ms)", addr);
	}
	if (cycle % 5 == 0) {
		LOG_DBG("Write 256B to 0x%08x (queue depth: %d)", addr, cycle % 8);
	}
}

/* Button 2: Flash corruption and recovery sequence */
void flash_mgr_corruption(void)
{
	LOG_ERR("CRC mismatch at sector 0x00080000 (expected: 0xA3F1, got: 0x0000)");
	LOG_WRN("Wear level critical on sector 0x00080000 (writes: 99847)");
	LOG_ERR("Flash write failed at 0x00080000 (ECC error)");
	LOG_INF("Sector 0x00080000 marked bad, remapping to 0x000A0000");
	LOG_INF("Flash recovery complete, 1 sector remapped");
}
```

## src/modules.h
```c
/*
 * LogScope Demo — shared declarations for simulated modules
 */

#ifndef LOGSCOPE_DEMO_MODULES_H
#define LOGSCOPE_DEMO_MODULES_H

#include <stdint.h>
#include <stdbool.h>

/* Sensor driver */
void sensor_drv_init(void);
void sensor_drv_read(int cycle);
uint32_t sensor_drv_get_value(void);
void sensor_drv_anomaly(bool connected);

/* Flash manager */
void flash_mgr_init(void);
void flash_mgr_tick(int cycle);
void flash_mgr_corruption(void);

/* Crypto manager */
void crypto_mgr_init(void);
void crypto_mgr_tick(int cycle);

/* Bluetooth LE manager */
void ble_mgr_init(void);
void ble_mgr_tick(int cycle);
void ble_mgr_on_connected(void);
void ble_mgr_on_disconnected(void);
void ble_mgr_send_notification(uint32_t value);
void ble_mgr_toggle_advertising(void);
void ble_mgr_force_disconnect(void);
struct bt_conn *ble_mgr_get_conn(void);
void ble_mgr_set_conn(struct bt_conn *conn);

/* Burst mode */
void burst_run(int *remaining);

#endif
```

## src/sensor_drv.c
```c
/*
 * Simulated sensor driver — temperature, humidity, accelerometer
 * Registers as its own Zephyr log module for proper filtering in LogScope.
 */

#include <zephyr/kernel.h>
#include <zephyr/logging/log.h>
#include "modules.h"

LOG_MODULE_REGISTER(sensor_drv, LOG_LEVEL_DBG);

static uint32_t sensor_value;

void sensor_drv_init(void)
{
	LOG_INF("Initializing temperature + humidity + accelerometer");
	LOG_DBG("I2C bus scan: found 3 devices at 0x48, 0x40, 0x68");
	LOG_INF("Sensor calibration loaded (factory defaults)");
}

void sensor_drv_read(int cycle)
{
	sensor_value += 17 + (cycle % 7);
	int16_t temp = 2200 + (cycle % 50) - 25;
	uint16_t humidity = 4500 + (cycle % 100);
	int16_t accel_x = (cycle * 3) % 200 - 100;
	int16_t accel_y = (cycle * 7) % 200 - 100;
	int16_t accel_z = 980 + (cycle % 20) - 10;

	LOG_DBG("Temp: %d.%02dC, Humidity: %d.%02d%%, Accel: (%d, %d, %d) mg",
		temp / 100, temp % 100, humidity / 100, humidity % 100,
		accel_x, accel_y, accel_z);
}

uint32_t sensor_drv_get_value(void)
{
	return sensor_value;
}

/* Button 1: Sensor anomaly sequence */
static int anomaly_step;

void sensor_drv_anomaly(bool connected)
{
	/* Trigger multi-step anomaly sequence (processed in main loop ticks) */
	anomaly_step = 1;
	LOG_INF("Anomaly detected: temperature spike to 85.2C (threshold: 60.0C)");

	if (connected) {
		/* Burst 10 rapid notifications when BLE is active */
		for (int i = 1; i <= 10; i++) {
			LOG_DBG("Notify: temp=85.2C humidity=12%% (anomaly burst %d/10)", i);
		}
	}

	LOG_WRN("Thermal threshold exceeded, initiating cooldown");
	LOG_ERR("Sensor read timeout during thermal event (retry 1/3)");
	LOG_INF("Temperature returning to normal: 24.8C");

	if (connected) {
		LOG_INF("Anomaly burst complete, resuming normal interval");
	}
}
```
